## testESPPost/main/Kconfig.projbuild
```kconfig
menu "Configuração do Wi-fi"

    config ESP_WIFI_SSID
        string "Wifi SSID"
        default "ssid"
        help
            Nome da rede Wifi.

    config ESP_WIFI_PASSWORD
        string "Senha do Wifi"
        default "password"
        help
            Senha do Wifi (WPA OU WPA2).
        
    config ESP_MAXIMUM_RETRY
        int "Número máximo de tentativas de conexão"
        default 5
        help
            Configure o valor máximo de tentativas de conexão.
endmenu
```
